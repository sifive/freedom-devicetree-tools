/include/ "core.dts"
/ {
	chosen {
		metal,entry = <&testram0 0 0>;
		metal,boothart = <&L3>;
	};
};
&L7 {
	testram0: testram@20000000 {
		compatible = "sifive,testram0";
		reg = <0x20000000 0x1fffffff>;
		reg-names = "mem";
	};
};
